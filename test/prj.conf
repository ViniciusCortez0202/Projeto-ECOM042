## CMakeLists.txt
```
# SPDX-License-Identifier: Apache-2.0

cmake_minimum_required(VERSION 3.20.0)

set(ZEPHYR_EXTRA_MODULES "${CMAKE_CURRENT_SOURCE_DIR}/../modules/camera_service/")

find_package(Zephyr REQUIRED HINTS $ENV{ZEPHYR_BASE})
project(projeto)

target_include_directories(app PRIVATE
  ${CMAKE_CURRENT_LIST_DIR}/../src
)

target_sources(app PRIVATE         
        src/main.c
        src/test_plate.c
        src/test_radar_processing.c
        src/test_radar_display.c

        ${CMAKE_CURRENT_LIST_DIR}/../src/plate.c
        ${CMAKE_CURRENT_LIST_DIR}/../src/radar_processing.c
        ${CMAKE_CURRENT_LIST_DIR}/../src/radar_display.c
        ${CMAKE_CURRENT_LIST_DIR}/../src/sensor.c
        ${CMAKE_CURRENT_LIST_DIR}/../src/vehicle_infraction_plate.c
    )
```

## prj.conf
```kconfig
CONFIG_LOG=n
CONFIG_LOG_DEFAULT_LEVEL=3

CONFIG_MAIN_STACK_SIZE=2048

CONFIG_GPIO=y

CONFIG_DISPLAY=y

CONFIG_ZBUS=y

CONFIG_ZBUS=y
CONFIG_ZBUS_MSG_SUBSCRIBER=y

CONFIG_TEST_RANDOM_GENERATOR=y

CONFIG_QEMU_ICOUNT=n

CONFIG_ZTEST=y
```

## src/main.c
```c
#include <zephyr/ztest.h>


ZTEST_SUITE(app_tests, NULL, NULL, NULL, NULL, NULL);
```

## src/test_plate.c
```c
#include <zephyr/ztest.h>
#include "plate.h"

ZTEST(app_tests, test_plate_br_valid)
{
    zassert_true(plate_is_br("ABC1D23"), NULL);
}

ZTEST(app_tests, test_plate_br_invalid)
{
    zassert_false(plate_is_br("ABC 1123"), NULL);
}

ZTEST(app_tests, test_plate_ar_valid)
{
    zassert_true(plate_is_ar("AB 142 LH"), NULL);
}

ZTEST(app_tests, test_plate_ar_invalid)
{
    zassert_false(plate_is_ar("BC 1A2 LH"), NULL);
}

ZTEST(app_tests, test_plate_pr_valid)
{
    zassert_true(plate_is_pr("ABCD 234"), NULL);
}

ZTEST(app_tests, test_plate_pr_invalid)
{
    zassert_false(plate_is_pr("A1C 1234"), NULL);
}

ZTEST(app_tests, test_plate_pr_motorcycle_valid)
{
    zassert_true(plate_is_pr("123 ADFC"), NULL);
}

ZTEST(app_tests, test_plate_pr_motorcycle_invalid)
{
    zassert_false(plate_is_pr("A23 WWWW"), NULL);
}

ZTEST(app_tests, test_plate_ur_valid)
{
    zassert_true(plate_is_ur("ABC 1234"), NULL);
}

ZTEST(app_tests, test_plate_ur_invalid)
{
    zassert_false(plate_is_ur("AC4 0001"), NULL);
}

ZTEST(app_tests, test_plate_bo_valid)
{
    zassert_true(plate_is_bo("BB 12341"), NULL);
}

ZTEST(app_tests, test_plate_bo_invalid)
{
    zassert_false(plate_is_bo("11 AAAAA"), NULL);
}

ZTEST(app_tests, test_mercosul_plate_valid)
{
    zassert_true(plate_is_valid_mercosul("590 VBEA"), NULL);
}

ZTEST(app_tests, test_mercosul_plate_invalid)
{
    zassert_false(plate_is_valid_mercosul("KHI7Y3E"), NULL);
}
```

## src/test_radar_display.c
```c
#include <zephyr/ztest.h>
#include "radar_display.h"

ZTEST(app_tests, test_str_type_light)
{
    zassert_equal(vehicle_type_str(VEHICLE_TYPE_LIGHT), "LEVE", NULL);
}

ZTEST(app_tests, test_str_type_heavy)
{
    zassert_equal(vehicle_type_str(VEHICLE_TYPE_HEAVY), "PESADO", NULL);
}

ZTEST(app_tests, test_str_status_normal)
{
    zassert_equal(status_str(RADAR_STATUS_NORMAL), "NORMAL", NULL);
}

ZTEST(app_tests, test_str_status_warning)
{
    zassert_equal(status_str(RADAR_STATUS_WARNING), "ATENÇÃO", NULL);
}

ZTEST(app_tests, test_str_status_infraction)
{
    zassert_equal(status_str(RADAR_STATUS_INFRACTION), "INFRAÇÃO", NULL);
}

ZTEST(app_tests, test_str_status_unknown)
{
    zassert_equal(status_str(10), "DESCONHECIDO", NULL);
}
```

## src/test_radar_processing.c
```c
#include <zephyr/ztest.h>
#include "radar_processing.h"
#include "radar_display.h"
#include "sensor.h"


ZTEST(app_tests, test_computed_speed_normal)
{
    int32_t speed = compute_speed_kmh(1000, 120);

    zassert_equal(speed, 30, NULL);
}

ZTEST(app_tests, test_computed_speed_attention)
{
    int32_t speed = compute_speed_kmh(1000, 40);

    zassert_equal(speed, 90, NULL);
}

ZTEST(app_tests, test_computed_speed_infraction)
{
    int32_t speed = compute_speed_kmh(1000, 20);

    zassert_equal(speed, 180, NULL);
}

ZTEST(app_tests, test_computed_vehicle_type_light)
{
    struct sensor_event evt = {
        .sensor_id = 1,
        .level = 1,
        .timestamp_ms = k_uptime_get_32(),
    };

    init_context(&evt);
    add_axle();

    evt.sensor_id = 2;
    evt.level = 1;
    evt.timestamp_ms += 120;

    register_timestamp_sensor2(&evt);

    struct radar_display_data disp;

	compute_vehicle_status(&disp);

    zassert_equal(disp.type, VEHICLE_TYPE_LIGHT, NULL);
}

ZTEST(app_tests, test_computed_vehicle_type_heavy)
{
    struct sensor_event evt = {
        .sensor_id = 1,
        .level = 1,
        .timestamp_ms = k_uptime_get_32(),
    };

    init_context(&evt);
    add_axle();
    add_axle();

    evt.sensor_id = 2;
    evt.level = 1;
    evt.timestamp_ms += 120;

    register_timestamp_sensor2(&evt);

    struct radar_display_data disp;

	compute_vehicle_status(&disp);

    zassert_equal(disp.type, VEHICLE_TYPE_HEAVY, NULL);
}

ZTEST(app_tests, test_computed_vehicle_status_normal_to_light_vehicle)
{
    struct sensor_event evt = {
        .sensor_id = 1,
        .level = 1,
        .timestamp_ms = k_uptime_get_32(),
    };

    init_context(&evt);
    add_axle();

    evt.sensor_id = 2;
    evt.level = 1;
    evt.timestamp_ms += 120;

    register_timestamp_sensor2(&evt);

    struct radar_display_data disp;

	compute_vehicle_status(&disp);

    zassert_equal(disp.status, RADAR_STATUS_NORMAL, NULL);
}

ZTEST(app_tests, test_computed_vehicle_status_attention_to_light_vehicle)
{
    struct sensor_event evt = {
        .sensor_id = 1,
        .level = 1,
        .timestamp_ms = k_uptime_get_32(),
    };

    init_context(&evt);
    add_axle();

    evt.sensor_id = 2;
    evt.level = 1;
    evt.timestamp_ms += 50;

    register_timestamp_sensor2(&evt);
    
    struct radar_display_data disp;
    
	compute_vehicle_status(&disp);

    zassert_equal(disp.status, RADAR_STATUS_WARNING, NULL);
}

ZTEST(app_tests, test_computed_vehicle_status_infraction_to_light_vehicle)
{
    struct sensor_event evt = {
        .sensor_id = 1,
        .level = 1,
        .timestamp_ms = k_uptime_get_32(),
    };

    init_context(&evt);
    add_axle();

    evt.sensor_id = 2;
    evt.level = 1;
    evt.timestamp_ms += 20;

    register_timestamp_sensor2(&evt);

    struct radar_display_data disp;

	compute_vehicle_status(&disp);

    zassert_equal(disp.status, RADAR_STATUS_INFRACTION, NULL);
}

ZTEST(app_tests, test_computed_vehicle_status_normal_to_heavy_vehicle)
{
    struct sensor_event evt = {
        .sensor_id = 1,
        .level = 1,
        .timestamp_ms = k_uptime_get_32(),
    };

    init_context(&evt);
    add_axle();
    add_axle();

    evt.sensor_id = 2;
    evt.level = 1;
    evt.timestamp_ms += 120;

    register_timestamp_sensor2(&evt);

    struct radar_display_data disp;

	compute_vehicle_status(&disp);

    zassert_equal(disp.status, RADAR_STATUS_NORMAL, NULL);
}

ZTEST(app_tests, test_computed_vehicle_status_attention_to_heavy_vehicle)
{
    struct sensor_event evt = {
        .sensor_id = 1,
        .level = 1,
        .timestamp_ms = k_uptime_get_32(),
    };

    init_context(&evt);
    add_axle();
    add_axle();

    evt.sensor_id = 2;
    evt.level = 1;
    evt.timestamp_ms += 60;

    register_timestamp_sensor2(&evt);
    
    struct radar_display_data disp;
    
	compute_vehicle_status(&disp);

    zassert_equal(disp.status, RADAR_STATUS_WARNING, NULL);
}

ZTEST(app_tests, test_computed_vehicle_status_infraction_to_heavy_vehicle)
{
    struct sensor_event evt = {
        .sensor_id = 1,
        .level = 1,
        .timestamp_ms = k_uptime_get_32(),
    };

    init_context(&evt);
    add_axle();
    add_axle();

    evt.sensor_id = 2;
    evt.level = 1;
    evt.timestamp_ms += 20;

    register_timestamp_sensor2(&evt);

    struct radar_display_data disp;

	compute_vehicle_status(&disp);

    zassert_equal(disp.status, RADAR_STATUS_INFRACTION, NULL);
}
```
