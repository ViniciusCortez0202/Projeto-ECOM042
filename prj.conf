## CMakeLists.txt
```
# SPDX-License-Identifier: Apache-2.0

cmake_minimum_required(VERSION 3.20.0)

set(ZEPHYR_EXTRA_MODULES "${CMAKE_CURRENT_SOURCE_DIR}/modules/camera_service/")

find_package(Zephyr REQUIRED HINTS $ENV{ZEPHYR_BASE})
project(projeto)

target_sources(app PRIVATE 
        src/main.c
        src/sensor.c
        src/sensor_sim.c
        src/radar_processing.c
        src/radar_display.c
        src/vehicle_infraction_plate.c
        src/plate.c
    )
```

## Kconfig
```
source "Kconfig.zephyr"

menu "Radar Eletrônico"

config RADAR_SENSOR_DISTANCE_MM
    int "Distância entre sensores (mm)"
    default 1000
    help
      Distância em milímetros entre os dois sensores magnéticos.

config RADAR_SPEED_LIMIT_LIGHT_KMH
    int "Limite de velocidade para veículos leves (km/h)"
    default 80

config RADAR_SPEED_LIMIT_HEAVY_KMH
    int "Limite de velocidade para veículos pesados (km/h)"
    default 60

config RADAR_WARNING_THRESHOLD_PERCENT
    int "Percentual para zona de alerta (%)"
    default 90
    range 1 100

config RADAR_CAMERA_FAILURE_RATE_PERCENT
    int "Chance de falha da câmera (%)"
    default 90
    range 0 100

endmenu
```

## prj.conf
```kconfig
CONFIG_LOG=y
CONFIG_LOG_DEFAULT_LEVEL=3

CONFIG_MAIN_STACK_SIZE=2048

CONFIG_GPIO=y

CONFIG_DISPLAY=y

CONFIG_ZBUS=y

CONFIG_ZBUS=y
CONFIG_ZBUS_MSG_SUBSCRIBER=y

CONFIG_TEST_RANDOM_GENERATOR=y

CONFIG_QEMU_ICOUNT=n
```

## src/main.c
```c
#include <zephyr/kernel.h>
#include <zephyr/logging/log.h>

#include "sensor.h"
#include "radar_processing.h"
#include "radar_display.h"

LOG_MODULE_REGISTER(radar, LOG_LEVEL_INF);

int main(void)
{
	int ret;

	LOG_INF("Iniciando o radar...");

	ret = sensor_init();
	if (ret < 0) {
		LOG_ERR("Erro ao iniciar sensor (err %d)", ret);
		return ret;
	}
	radar_processing_init();
	radar_display_init();

	LOG_INF("Radar inicializado.");
	return 0;
}
```

## src/camera_service.c
```c
#include <zephyr/kernel.h>
#include <zephyr/logging/log.h>
#include <zephyr/zbus/zbus.h>
#include <zephyr/random/random.h>

#include "radar_bus.h"
#include "plate.h"
#include "camera_service.h"

LOG_MODULE_DECLARE(radar);

ZBUS_MSG_SUBSCRIBER_DEFINE(msub_radar_infraction);

ZBUS_CHAN_ADD_OBS(chan_radar_infraction, msub_radar_infraction, 3);

//Função para definir se vai emitir uma placa errada ou não
static bool should_fail_capture(void)
{
	const uint32_t rate = (uint32_t)CONFIG_RADAR_CAMERA_FAILURE_RATE_PERCENT;

	if (rate == 0U) {
		return false;
	}
	if (rate >= 100U) {
		return true;
	}

	const uint32_t pct = sys_rand32_get() % 100U;
	return pct < rate;
}

static void camera_thread(void *a, void *b, void *c)
{
	ARG_UNUSED(a);
	ARG_UNUSED(b);
	ARG_UNUSED(c);

	LOG_INF("Iniciando câmera");

	while (1) {
		int err;
		const struct zbus_channel *chan;
		struct radar_infraction_msg inf = {0};

		err = zbus_sub_wait_msg(&msub_radar_infraction, &chan, &inf, K_FOREVER);
		if (err) {
			LOG_ERR("Falha ao receber mensagem do canal: %d", err);
			continue;
		}

		//Simula processamento de câmera/LPR
		k_sleep(K_MSEC(250));

		struct camera_result_msg out = {0};
		out.infraction = inf;

		bool fail = should_fail_capture();
		if (fail) {
			plate_generate_invalid(out.plate);
		} else {
			plate_generate_mercosul(out.plate);
		}

		out.plate_valid = plate_is_valid_mercosul(out.plate);

		// Publica resultado
		err = zbus_chan_pub(&chan_camera_result, &out, K_NO_WAIT);
		if (err) {
			LOG_ERR("zbus_chan_pub(camera_result) failed: %d", err);
			continue;
		}

		LOG_INF("Camera result: plate=%s valid=%d (speed=%d limit=%d type=%d)", out.plate,
			(int)out.plate_valid, out.infraction.speed_kmh, out.infraction.limit_kmh,
			(int)out.infraction.vehicle_type);
	}
}

K_THREAD_DEFINE(camera_thread_id, 1024, camera_thread, NULL, NULL, NULL, 7, 0, 0);
```

## src/camera_service.h
```c
#ifndef CAMERA_SERVICE_H
#define CAMERA_SERVICE_H


#endif /* CAMERA_SERVICE_H */
```

## src/plate.c
```c
#include "plate.h"
#include <stddef.h>
#include <regex.h>

bool plate_is_valid_mercosul(const char *plate)
{
	return plate_is_br(plate) || plate_is_ar(plate) || plate_is_pr(plate) ||
	       plate_is_ur(plate) || plate_is_bo(plate);
}

/*
	Cria um regex e valida, foi utilizada a biblioteca (https://man7.org/linux/man-pages/man3/regcomp.3.html)

	@param plate placa de um veículo
	@param pattern regex para validação

	@return valida de plate está dentro do pattern
*/
static bool plate_match_pattern(const char *plate, const char *pattern)
{
	regex_t rx;
	int rc = regcomp(&rx, pattern, REG_EXTENDED | REG_NOSUB);
	if (rc != 0) {
		return false;
	}

	bool ok = (regexec(&rx, plate, 0, NULL, 0) == 0);
	regfree(&rx);
	return ok;
}

/* Brasil */
bool plate_is_br(const char *plate)
{
	return plate_match_pattern(plate, "^[A-Z]{3}[0-9]{1}[A-Z]{1}[0-9]{2}$");
}

/* Argentina */
bool plate_is_ar(const char *plate)
{
	return plate_match_pattern(plate, "^[A-Z]{2} [0-9]{3} [A-Z]{2}$");
}

/* Paraguai */
bool plate_is_pr(const char *plate)
{
	return plate_match_pattern(plate, "^([A-Z]{4} [0-9]{3}|[0-9]{3} [A-Z]{4})$");
}

/* Uruguai */
bool plate_is_ur(const char *plate)
{
	return plate_match_pattern(plate, "^[A-Z]{3} [0-9]{4}$");
}

/* Bolivia */
bool plate_is_bo(const char *plate)
{
	return plate_match_pattern(plate, "^[A-Z]{2} [0-9]{5}$");
}
```

## src/plate.h
```c
#ifndef PLATE_H
#define PLATE_H

#include <stdbool.h>

/*
    Valida se uma string é uma placa de carro pertencente ao mercosul

    @param plate placa de um carro

    @return true se é uma placa do mercosul e false caso contrário
*/
bool plate_is_valid_mercosul(const char *plate);

/*
    Valida se uma string é uma placa de carro pertencente ao Brasil no padrão mercosul

    @param plate placa de um carro

    @return true se é uma placa do mercosul e false caso contrário
*/
bool plate_is_br(const char *plate);

/*
    Valida se uma string é uma placa de carro pertencente ao Argentina no padrão mercosul

    @param plate placa de um carro

    @return true se é uma placa do mercosul e false caso contrário
*/
bool plate_is_ar(const char *plate);

/*
    Valida se uma string é uma placa de carro pertencente ao Paraguai no padrão mercosul

    @param plate placa de um carro

    @return true se é uma placa do mercosul e false caso contrário
*/
bool plate_is_pr(const char *plate);

/*
    Valida se uma string é uma placa de carro pertencente ao Uruguai no padrão mercosul

    @param plate placa de um carro

    @return true se é uma placa do mercosul e false caso contrário
*/
bool plate_is_ur(const char *plate);

/*
    Valida se uma string é uma placa de carro pertencente ao Bolívia no padrão mercosul

    @param plate placa de um carro

    @return true se é uma placa do mercosul e false caso contrário
*/
bool plate_is_bo(const char *plate);

#endif /* PLATE_H */
```

## src/radar_bus.c
```c
#include "radar_bus.h"

/* Sem observers estáticos; vamos adicionar via ZBUS_CHAN_ADD_OBS nos módulos. */
ZBUS_CHAN_DEFINE(chan_radar_infraction,
		 struct radar_infraction_msg,
		 NULL, NULL,
		 ZBUS_OBSERVERS_EMPTY,
		 ZBUS_MSG_INIT(0));

ZBUS_CHAN_DEFINE(chan_camera_result,
		 struct camera_result_msg,
		 NULL, NULL,
		 ZBUS_OBSERVERS_EMPTY,
		 ZBUS_MSG_INIT(0));
```

## src/radar_bus.h
```c
#ifndef RADAR_BUS_H
#define RADAR_BUS_H

#include <stdint.h>
#include <stdbool.h>
#include <zephyr/zbus/zbus.h>

#include "radar_control.h"

struct radar_infraction_msg {
	enum vehicle_type vehicle_type;
	int32_t speed_kmh;
	int32_t limit_kmh;
	uint32_t timestamp_ms;
};

struct camera_result_msg {
	struct radar_infraction_msg infraction;
	char plate[8];
	bool plate_valid;
};

ZBUS_CHAN_DECLARE(chan_radar_infraction);
ZBUS_CHAN_DECLARE(chan_camera_result);

#endif /* RADAR_BUS_H */
```

## src/radar_control.c
```c
#include "radar_control.h"

/* Define se velocidade do veiculo esta dentro ou fora do limite estabelecido:
 *  - CONFIG_RADAR_SPEED_LIMIT_LIGHT_KMH
 *  - CONFIG_RADAR_SPEED_LIMIT_HEAVY_KMH
 *  - CONFIG_RADAR_WARNING_THRESHOLD_PERCENT
 */
struct radar_evaluation_result radar_evaluate_speed(enum vehicle_type type,
                                                    int32_t measured_speed_kmh)
{
    struct radar_evaluation_result res = {
        .type = type,
        .measured_speed_kmh = measured_speed_kmh,
        .limit_kmh = 0,
        .status = RADAR_STATUS_NORMAL,
    };

    if (type == VEHICLE_TYPE_LIGHT) {
        res.limit_kmh = CONFIG_RADAR_SPEED_LIMIT_LIGHT_KMH;
    } else {
        res.limit_kmh = CONFIG_RADAR_SPEED_LIMIT_HEAVY_KMH;
    }

    if (res.limit_kmh <= 0) {
        res.status = RADAR_STATUS_NORMAL;
        return res;
    }
   
    int32_t warning_speed =
        (res.limit_kmh * CONFIG_RADAR_WARNING_THRESHOLD_PERCENT) / 100;

    if (measured_speed_kmh > res.limit_kmh) {
        res.status = RADAR_STATUS_INFRACTION;
    } else if (measured_speed_kmh >= warning_speed) {
        res.status = RADAR_STATUS_WARNING;
    } else {
        res.status = RADAR_STATUS_NORMAL;
    }

    return res;
}
```

## src/radar_control.h
```c
#ifndef RADAR_CONTROL_H
#define RADAR_CONTROL_H

#include <stdint.h>

enum vehicle_type {
    VEHICLE_TYPE_LIGHT = 0,
    VEHICLE_TYPE_HEAVY = 1,
};

enum radar_infraction_status {
    RADAR_STATUS_NORMAL = 0,
    RADAR_STATUS_WARNING = 1,
    RADAR_STATUS_INFRACTION = 2,
};

struct radar_evaluation_result {
    enum vehicle_type type;
    int32_t measured_speed_kmh;
    int32_t limit_kmh;
    enum radar_infraction_status status;
};


struct radar_evaluation_result radar_evaluate_speed(enum vehicle_type type,
                                                    int32_t measured_speed_kmh);

#endif /* RADAR_CONTROL_H */
```

## src/radar_display.c
```c
#include <zephyr/device.h>
#include <zephyr/drivers/display.h>
#include <zephyr/kernel.h>
#include <zephyr/sys/printk.h>
#include <string.h>

#include "radar_display.h"
#include "radar_processing.h"

/*
	Cores do display
*/
#define ANSI_RED    "\x1b[31m"
#define ANSI_YELLOW "\x1b[33m"
#define ANSI_GREEN  "\x1b[32m"
#define ANSI_RESET  "\x1b[0m"

#if DT_NODE_EXISTS(DT_CHOSEN(zephyr_display))
#define DISPLAY_LABEL DT_LABEL(DT_CHOSEN(zephyr_display))
#else
#define DISPLAY_LABEL NULL
#endif

static const struct device *disp_dev;

int radar_display_init()
{
	if (DISPLAY_LABEL == NULL) {
		disp_dev = NULL;
		return -ENODEV;
	}

	disp_dev = device_get_binding(DISPLAY_LABEL);
	if (!disp_dev) {
		return -ENODEV;
	}

	if (!device_is_ready(disp_dev)) {
		disp_dev = NULL;
		return -ENODEV;
	}

	display_blanking_off(disp_dev);

	return 0;
}

char *vehicle_type_str(enum vehicle_type type)
{
	return (type == VEHICLE_TYPE_HEAVY) ? "PESADO" : "LEVE";
}

char *status_str(enum radar_infraction_status status)
{
	switch (status) {
	case RADAR_STATUS_NORMAL:
		return "NORMAL";
	case RADAR_STATUS_WARNING:
		return "ATENÇÃO";
	case RADAR_STATUS_INFRACTION:
		return "INFRAÇÃO";
	default:
		return "DESCONHECIDO";
	}
}

char *status_color(enum radar_infraction_status s)
{
	switch (s) {
	case RADAR_STATUS_NORMAL:
		return ANSI_GREEN;
	case RADAR_STATUS_WARNING:
		return ANSI_YELLOW;
	case RADAR_STATUS_INFRACTION:
		return ANSI_RED;
	default:
		return ANSI_RESET;
	}
}

/*
	Escreve no display utilizando o driver do zephyr
*/
static void update_dummy_display(const char *line)
{
	if (!disp_dev) {
		return;
	}

	uint8_t buf[64];
	size_t n = strlen(line);
	if (n > sizeof(buf)) {
		n = sizeof(buf);
	}

	memcpy(buf, line, n);

	struct display_buffer_descriptor desc = {
		.buf_size = n,
		.width = (uint16_t)n,
		.height = 1,
		.pitch = (uint16_t)n,
	};

	display_write(disp_dev, 0, 0, &desc, buf);
}

void radar_display_show(const struct radar_display_data *data)
{
	if (!data) {
		return;
	}

	char line[128];

	/*
		Formata a saida do display
	*/
	snprintk(line, sizeof(line), "Veiculo=%s eixos=%u velocidade=%d limite=%d status=%s",
		 vehicle_type_str(data->type), data->axle_count, data->measured_speed_kmh,
		 data->limit_kmh, status_str(data->status));

	update_dummy_display(line);


	/* 
		Imprime no console o status e informações do veículo
	*/
	printk("%s[RADAR] %s%s\n", status_color(data->status), line, ANSI_RESET);
}
```

## src/radar_display.h
```c
#ifndef RADAR_DISPLAY_H
#define RADAR_DISPLAY_H

#include <stdint.h>
#include <stdbool.h>

/*
    Define o tipo de veículo com base 
    na quantidade de eixos
*/
enum vehicle_type {
    VEHICLE_TYPE_LIGHT = 0,
    VEHICLE_TYPE_HEAVY = 1,
};

/*
    Define o status com base 
    no limite do radar e tipo de veículo
*/
enum radar_infraction_status {
    RADAR_STATUS_NORMAL = 0,
    RADAR_STATUS_WARNING = 1,
    RADAR_STATUS_INFRACTION = 2,
};

/*
    Estrutura usada para transmitir ao display 
    o estado e informações do veiculo, além de informações
    do radar como limite da via para o tipo de
    veiculo
*/
struct radar_display_data {
    enum vehicle_type type;
    uint8_t axle_count;
    uint32_t delta_ms;
    int32_t measured_speed_kmh;
    int32_t limit_kmh;
    enum radar_infraction_status status;
};

/*
    Inicializa o display

    @retorna 0 caso consiga inicializar e -ENODEV caso a operação não seja permitida
*/
int radar_display_init();

/*
    Exibi as informações no display e no console

    @param data estrutura com informações do veículo e do rada
*/
void radar_display_show(const struct radar_display_data *data);


/*
	Formata a saida do tipo de veículo no display

	@param type tipo do veículo conforme os eixos

	@return uma string com o tipo de veículo
		- Pesado (3 eixos ou mais)
		- Leve (menos de 3 eixo)
*/
char *vehicle_type_str(enum vehicle_type type);

/*
	Formata a saída do tipo de veículo no display
	
	@param status status do veículo conforme velocidade da via e tipo de veículo

	@return uma string com o status do veículo
		- Normal (dentro da velocidade da via para o tipo de veículo)
		- Atenção (a uma a velocidade perto do limite da via para o tipo de veículo)
		- Infração (acima da velocidade da via para o tipo de veículo)
*/
char *status_str(enum radar_infraction_status status);

/*
	Formata a saída do tipo de veículo no display

	@param status status do veículo conforme velocidade da via e tipo de veículo

	@return uma string com a cor conforme o status
*/
char *status_color(enum radar_infraction_status s);


#endif /* RADAR_DISPLAY_H */
```

## src/radar_processing.c
```c
#include <zephyr/kernel.h>
#include <zephyr/logging/log.h>
#include <zephyr/zbus/zbus.h>

#include "radar_processing.h"
#include "radar_display.h"
#include "sensor.h"
#include "vehicle_infraction_plate.h"

#define VEHICLE_LENGTH_MM 5000

LOG_MODULE_DECLARE(radar);

/*
	Estado de captura do sistema
*/
enum vehicle_track_state {
	VEHICLE_STATE_IDLE = 0,
	VEHICLE_STATE_TRACKING = 1,
};

/*
	Estrutura de contexto para salvar os dados
	do veículo que está passando pelo radar
*/
struct vehicle_context {
	enum vehicle_track_state state;
	uint32_t start_time_ms;
	uint32_t sensor2_time_ms;
	bool sensor2_seen;
	uint8_t axle_count;
	struct k_work_delayable finalize_work;
};

static struct vehicle_context ctx;

/* timeout para determinar quando o último eixo do veículo já passou */
int32_t radar_stop_timeout = 500;

/*
	Limpa o estado do contexto
*/
static void vehicle_context_reset(struct vehicle_context *c)
{
	c->state = VEHICLE_STATE_IDLE;
	c->axle_count = 0;
	c->start_time_ms = 0;
	radar_stop_timeout = 500;
}

int32_t compute_speed_kmh(uint32_t distance_mm, uint32_t delta_ms)
{
	if (delta_ms == 0) {
		return 0;
	}

	return (int32_t)((distance_mm * 36U) / (delta_ms * 10U));
}

void compute_timeout()
{
	uint32_t distance_mm = CONFIG_RADAR_SENSOR_DISTANCE_MM;
	uint32_t delta_ms = ctx.sensor2_time_ms - ctx.start_time_ms;
	int32_t speed_kmh = compute_speed_kmh(distance_mm, delta_ms);
	radar_stop_timeout = ((int64_t)VEHICLE_LENGTH_MM * 3600) / ((int64_t)speed_kmh * 1000);
}

void init_context(const struct sensor_event *evt)
{
	ctx.state = VEHICLE_STATE_TRACKING;
	ctx.axle_count = 1;
	ctx.start_time_ms = evt->timestamp_ms;
	ctx.sensor2_seen = false;
}

void add_axle()
{
	ctx.axle_count++;
}

void register_timestamp_sensor2(const struct sensor_event *evt)
{
	ctx.sensor2_seen = true;
	ctx.sensor2_time_ms = evt->timestamp_ms;
}

int compute_vehicle_status(struct radar_display_data *disp)
{
	if (!ctx.sensor2_seen || ctx.state != VEHICLE_STATE_TRACKING || ctx.axle_count == 1) {
		LOG_WRN("Possível ruido");
		vehicle_context_reset(&ctx);
		return -1;
	}

	uint32_t delta_ms = ctx.sensor2_time_ms - ctx.start_time_ms;
	uint32_t distance_mm = CONFIG_RADAR_SENSOR_DISTANCE_MM;
	int32_t speed_kmh = compute_speed_kmh(distance_mm, delta_ms);
	enum vehicle_type vtype = ctx.axle_count >= 3 ? VEHICLE_TYPE_HEAVY : VEHICLE_TYPE_LIGHT;
	int32_t limit_kmh;
	if (vtype == VEHICLE_TYPE_LIGHT) {
		limit_kmh = CONFIG_RADAR_SPEED_LIMIT_LIGHT_KMH;
	} else {
		limit_kmh = CONFIG_RADAR_SPEED_LIMIT_HEAVY_KMH;
	}

	enum radar_infraction_status status;
	int32_t warning_speed = (limit_kmh * CONFIG_RADAR_WARNING_THRESHOLD_PERCENT) / 100;
	if (speed_kmh > limit_kmh) {
		status = RADAR_STATUS_INFRACTION;
	} else if (speed_kmh >= warning_speed) {
		status = RADAR_STATUS_WARNING;
	} else {
		status = RADAR_STATUS_NORMAL;
	}

	*disp = (struct radar_display_data){
		.type = vtype,
		.axle_count = ctx.axle_count,
		.delta_ms = delta_ms,
		.measured_speed_kmh = speed_kmh,
		.limit_kmh = limit_kmh,
		.status = status,
	};

	return 0;
}

/*
	Responsável por emitir ao display quando o timer disparar
	e limpa o estado para o próximo veículo
*/
static void finalize_vehicle_work(struct k_work *work)
{
	ARG_UNUSED(work);

	struct radar_display_data disp;
	if (compute_vehicle_status(&disp) == 0) {
		radar_display_show(&disp);
	}
	/*
		Caso o veículo tenha cometido a infração ele dispara a captura de placa
	*/
	if (disp.status == RADAR_STATUS_INFRACTION) {
		handler_plate_infraction();
	}

	vehicle_context_reset(&ctx);
}

void radar_process_sensor_event(const struct sensor_event *evt)
{
	if (!evt) {
		return;
	}

	/*
		Faz a verificação de estado alternando de IDLE para TRACKING.
		Para sair de IDLE a função deve receber um evt do sensor 1
		A contagem de eixos é atualizada conforme o veículo passa pelo sensor 1,
		assim o sensor 2 serve apenas para calcular a velocidade do veículo.

		Sempre que um novo eixo é contado o timeout é zerado com base em
	   @radar_stop_timeout, que é calculado a partir da velocidade obtida depois da leitura do
	   segundo sensor.
	*/
	switch (ctx.state) {
	case VEHICLE_STATE_IDLE:
		if (evt->sensor_id == 1 && evt->level == 1) {
			init_context(evt);
			k_work_reschedule(&ctx.finalize_work, K_MSEC(radar_stop_timeout));
		}
		break;

	case VEHICLE_STATE_TRACKING:
		if (evt->sensor_id == 1 && evt->level == 1) {
			add_axle();
			k_work_reschedule(&ctx.finalize_work, K_MSEC(radar_stop_timeout));
		}

		if (evt->sensor_id == 2 && evt->level == 1 && !ctx.sensor2_seen) {
			register_timestamp_sensor2(evt);
			compute_timeout();
		}

		break;
	}
}

void radar_processing_init()
{
	vehicle_context_reset(&ctx);
	k_work_init_delayable(&ctx.finalize_work, finalize_vehicle_work);
}
```

## src/radar_processing.h
```c
#ifndef RADAR_PROCESSING_H
#define RADAR_PROCESSING_H

#include "sensor.h"
#include "radar_display.h"


/*
    Inicializa o contexto zerado e o k_work com a função de finalização
*/
void radar_processing_init();

/*
    Faz a alternancia de estado entre inicial e quando o veículo passa pelos sensores,
    detectando a quantidade de eixos e guardando o intervalo de leitura no contexto

    @param evt dados do sensor foi acionado
*/
void radar_process_sensor_event(const struct sensor_event *evt);

/*
    Calcula a velocidade média do veículo

    @param distance_mm distância entre os sensores 1 e 2
    @param delta_ms variação de tempo entre a primeira leitura no sensor 1 e do sensor 2

    @return ((distance_mm * 36) / (delta_ms * 10))
*/
int32_t compute_speed_kmh(uint32_t distance_mm, uint32_t delta_ms);

/*
    Computa qual é o estado do veiculo:
    - NORMAL
    - ATENÇÃO
    - INFRAÇÃO
    e monta o objeto de display com status da infração e velocidade

    @param disp parâmetro de saída com informações do display

    @return 0 caso consiga montar o objeto ou -1 em caso de ruido do sensor
*/
int compute_vehicle_status(struct radar_display_data *disp);

/*
    Atualiza o contexto quado o veículo passa pelo primeiro sensor

    @param evt primeiro disparo do sensor quando o estado é IDLE
*/
void init_context(const struct sensor_event *evt);

/*
    Adiciona 1 eixo a contagem
*/
void add_axle();

/*
    Atualiza o contexto com a leitura do segundo sensor
*/
void register_timestamp_sensor2(const struct sensor_event *evt);

/*
    Calcula o timeout da chamada da função de finalização
    com base na velocidade do automóvel
*/
void compute_timeout();

#endif /* RADAR_PROCESSING_H */
```
