## build/Kconfig/arch/Kconfig
```kconfig
# Load Zephyr Arch Kconfig descriptions.
osource "/Users/viniciuscortez/zephyrproject/zephyr/arch/rx/Kconfig"
osource "/Users/viniciuscortez/zephyrproject/zephyr/arch/x86/Kconfig"
osource "/Users/viniciuscortez/zephyrproject/zephyr/arch/xtensa/Kconfig"
osource "/Users/viniciuscortez/zephyrproject/zephyr/arch/sparc/Kconfig"
osource "/Users/viniciuscortez/zephyrproject/zephyr/arch/riscv/Kconfig"
osource "/Users/viniciuscortez/zephyrproject/zephyr/arch/posix/Kconfig"
osource "/Users/viniciuscortez/zephyrproject/zephyr/arch/mips/Kconfig"
osource "/Users/viniciuscortez/zephyrproject/zephyr/arch/arm64/Kconfig"
osource "/Users/viniciuscortez/zephyrproject/zephyr/arch/arm/Kconfig"
osource "/Users/viniciuscortez/zephyrproject/zephyr/arch/arc/Kconfig"
```

## build/Kconfig/boards/Kconfig
```kconfig
# Load Zephyr board Kconfig descriptions.
osource "/Users/viniciuscortez/zephyrproject/zephyr/boards/arm/mps2/Kconfig"
```

## build/Kconfig/boards/Kconfig.defconfig
```kconfig
# Load Zephyr board defconfig descriptions.
osource "/Users/viniciuscortez/zephyrproject/zephyr/boards/arm/mps2/Kconfig.defconfig"
```

## build/Kconfig/boards/Kconfig.mps2
```kconfig
# Load board Kconfig descriptions.
osource "/Users/viniciuscortez/zephyrproject/zephyr/boards/arm/mps2/Kconfig.mps2"
```

## build/Kconfig/boards/Kconfig.sysbuild
```kconfig
# Load Sysbuild board Kconfig descriptions.
osource "/Users/viniciuscortez/zephyrproject/zephyr/boards/arm/mps2/Kconfig.sysbuild"
```
